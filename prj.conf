## CMakeLists.txt
```
cmake_minimum_required(VERSION 3.20.0)
find_package(Zephyr REQUIRED HINTS $ENV{ZEPHYR_BASE})
project(treecast_demo)

target_sources(app PRIVATE
    src/main.c
    src/treecast.c
    src/crypto_backend.c
    src/soft_aes.c
)
```

## prj.conf
```kconfig
# --- Zephyr System Heap ---
CONFIG_MAIN_STACK_SIZE=10240
CONFIG_HEAP_MEM_POOL_SIZE=32768

CONFIG_LOG=y
CONFIG_PRINTK=y
CONFIG_SERIAL=y
CONFIG_CONSOLE=y
CONFIG_UART_CONSOLE=y

# --- NORDIC SECURITY ---
# Enabled to link Oberon ECC/SHA
CONFIG_NRF_SECURITY=y
CONFIG_PSA_CRYPTO_DRIVER_OBERON=y

# --- DISABLE HARDWARE ---
CONFIG_PSA_CRYPTO_DRIVER_CC3XX=n
CONFIG_ENTROPY_CC3XX=n

# --- RNG ---
CONFIG_ENTROPY_GENERATOR=y
CONFIG_TEST_RANDOM_GENERATOR=y

CONFIG_WARN_DEPRECATED=n
```

## nrf5340dk_nrf5340_cpuapp.overlay
```dts
// To get started, press Ctrl+Space (or Option+Esc) to bring up the completion menu and view the available nodes.

// You can also use the buttons in the sidebar to perform actions on nodes.
// Actions currently available include:

// * Enabling / disabling the node
// * Adding the bus to a bus
// * Removing the node
// * Connecting ADC channels

// For more help, browse the DeviceTree documentation at https://docs.zephyrproject.org/latest/guides/dts/index.html
// You can also visit the nRF DeviceTree extension documentation at https://docs.nordicsemi.com/bundle/nrf-connect-vscode/page/guides/ncs_configure_app.html#devicetree-support-in-the-extension
```

## src/main.c
```c
#include <zephyr/kernel.h>
#include <zephyr/sys/printk.h>
#include <zephyr/sys_clock.h>
#include <math.h>

#include "treecast.h"

#define NUM_DEVICES   8
#define NUM_ITERS     100
#define MSG_SIZE      64

/* Assume nRF5340 application core at 64 MHz */
#define CPU_FREQ_HZ   64000000u

static treecast_ctx_t g_ctx;

/* Average costs of primitive operations (per *single* operation, in timer cycles) */
static uint32_t cost_kgen_cycles  = 0;
static uint32_t cost_hash_cycles  = 0;
static uint32_t cost_ecdh_cycles  = 0;
static uint32_t cost_aes_cycles   = 0;


/* Timing helpers */
#define BENCH_START() uint32_t __bench_start = k_cycle_get_32()
#define BENCH_END(acc)                                                        \
    do {                                                                      \
        uint32_t __bench_end = k_cycle_get_32();                              \
        (acc) += (uint64_t)(__bench_end - __bench_start);                     \
    } while (0)

/* Convert timer cycles (system clock) to nanoseconds */
static inline uint64_t cycles_to_ns(uint64_t cycles)
{
    return (cycles * 1000000000ull) / CONFIG_SYS_CLOCK_HW_CYCLES_PER_SEC;
}

/* Convert timer cycles to estimated CPU cycles (64 MHz core) */
static inline uint64_t timer_to_cpu_cycles(uint32_t timer_cycles)
{
    return ((uint64_t)timer_cycles * CPU_FREQ_HZ) /
           (uint64_t)CONFIG_SYS_CLOCK_HW_CYCLES_PER_SEC;
}

static void print_cycles_time(const char *label,
                              uint32_t cycles_per_op,
                              uint32_t iters)
{
    if (cycles_per_op == 0) {
        printk("%s\n", label);
        printk("      - per-op:   %10u timer cycles ( < 1 tick )\n",
               cycles_per_op);
        printk("      - over %3u:          0 timer cycles\n", iters);
        return;
    }

    uint64_t total_cycles = (uint64_t)cycles_per_op * iters;
    uint64_t total_ns     = cycles_to_ns(total_cycles);

    uint32_t total_ms_int  = (uint32_t)(total_ns / 1000000ull);
    uint32_t total_ms_frac = (uint32_t)((total_ns % 1000000ull) / 1000ull);

    uint64_t per_ns     = cycles_to_ns(cycles_per_op);
    uint32_t per_ms_int  = (uint32_t)(per_ns / 1000000ull);
    uint32_t per_ms_frac = (uint32_t)((per_ns % 1000000ull) / 1000ull);

    uint64_t per_cpu_cycles   = timer_to_cpu_cycles(cycles_per_op);
    uint64_t total_cpu_cycles = timer_to_cpu_cycles((uint32_t)total_cycles);

    printk("%s\n", label);
    printk("      - per-op:   %10u timer cycles (%12llu CPU cycles) = %4u.%03u ms\n",
           cycles_per_op,
           (unsigned long long)per_cpu_cycles,
           per_ms_int, per_ms_frac);
    printk("      - over %3u: %10llu timer cycles (%12llu CPU cycles) = %4u.%03u ms\n",
           iters,
           (unsigned long long)total_cycles,
           (unsigned long long)total_cpu_cycles,
           total_ms_int, total_ms_frac);
}

static void print_primitive_cycle_table(void)
{
    printk("\n[1b] Timer vs CPU cycles (per operation, NUM_ITERS=%d)\n",
           NUM_ITERS);
    printk("   Assumed CPU clock: %u Hz\n", CPU_FREQ_HZ);
    printk("   System timer clock: %u Hz (CONFIG_SYS_CLOCK_HW_CYCLES_PER_SEC)\n",
           CONFIG_SYS_CLOCK_HW_CYCLES_PER_SEC);

    printk("   ----------------------------------------------------------\n");
    printk("   | Op       | Timer cycles |    CPU cycles (approx)       |\n");
    printk("   |----------|--------------|------------------------------|\n");

    if (cost_kgen_cycles) {
        printk("   | KGEN     | %12u | %12llu |\n",
               cost_kgen_cycles,
               (unsigned long long)timer_to_cpu_cycles(cost_kgen_cycles));
    }
    if (cost_hash_cycles) {
        printk("   | HASH     | %12u | %12llu |\n",
               cost_hash_cycles,
               (unsigned long long)timer_to_cpu_cycles(cost_hash_cycles));
    }
    if (cost_ecdh_cycles) {
        printk("   | HDH      | %12u | %12llu |\n",
               cost_ecdh_cycles,
               (unsigned long long)timer_to_cpu_cycles(cost_ecdh_cycles));
    }
    if (cost_aes_cycles) {
        printk("   | ENC(AES) | %12u | %12llu |\n",
               cost_aes_cycles,
               (unsigned long long)timer_to_cpu_cycles(cost_aes_cycles));
    }

    printk("   ----------------------------------------------------------\n");
}


/* [1] Primitive cryptographic operations */
static void benchmark_atomics(void)
{
    printk("\n[1] Primitive operations (NUM_ITERS=%d, MSG_SIZE=%d bytes)\n",
           NUM_ITERS, MSG_SIZE);

    uint8_t buf[MSG_SIZE] = {0};
    uint8_t out[32];
    uint8_t iv[12] = {0};
    uint8_t tag[16];
    int ret = 0;

    /* 1. EC key generation (P-256) */
    k_sleep(K_MSEC(100));
    {
        uint64_t total = 0;
        tc_ec_keypair_t tmp;

        for (int i = 0; i < NUM_ITERS; i++) {
            BENCH_START();
            ret = tc_ec_keypair_gen(&tmp);
            BENCH_END(total);

            if (ret != 0) {
                printk("   [KGEN] ERROR at iter %d (ret=%d)\n", i, ret);
                return;
            }
        }

        cost_kgen_cycles = (uint32_t)(total / NUM_ITERS);
        print_cycles_time("   [KGEN] EC key generation (secp256r1 sk,pk)",
                          cost_kgen_cycles, NUM_ITERS);
    }

    /* 2. Hash (SHA-256) on 64 bytes */
    k_sleep(K_MSEC(100));
    {
        uint64_t total = 0;

        for (int i = 0; i < NUM_ITERS; i++) {
            BENCH_START();
            ret = tc_hash(buf, sizeof(buf), out);
            BENCH_END(total);

            if (ret != 0) {
                printk("   [HASH] ERROR at iter %d (ret=%d)\n", i, ret);
                return;
            }
        }

        cost_hash_cycles = (uint32_t)(total / NUM_ITERS);
        print_cycles_time("   [HASH] SHA-256 over 64-byte message",
                          cost_hash_cycles, NUM_ITERS);
    }

    /* 3. HDH = ECDH + hash, using two device keys */
    k_sleep(K_MSEC(100));
    {
        uint64_t total = 0;

        for (int i = 0; i < NUM_ITERS; i++) {
            BENCH_START();
            ret = tc_ec_hdh(g_ctx.dev_keys[0].priv,
                            g_ctx.dev_keys[1].pub,
                            out);
            BENCH_END(total);

            if (ret != 0) {
                printk("   [HDH ] ERROR at iter %d (ret=%d)\n", i, ret);
                return;
            }
        }

        cost_ecdh_cycles = (uint32_t)(total / NUM_ITERS);
        print_cycles_time("   [HDH ] P-256 ECDH + SHA-256 (pairwise secret)",
                          cost_ecdh_cycles, NUM_ITERS);
    }

    /* 4. Symmetric encryption (AES-CTR, 64-byte payload) */
    k_sleep(K_MSEC(100));
    {
        uint64_t total = 0;

        for (int i = 0; i < NUM_ITERS; i++) {
            BENCH_START();
            ret = tc_aes_ctr_encrypt(out, iv, sizeof(iv),
                                     buf, MSG_SIZE,
                                     buf, tag, sizeof(tag));
            BENCH_END(total);

            if (ret != 0) {
                printk("   [ENC ] ERROR at iter %d (ret=%d)\n", i, ret);
                return;
            }
        }

        cost_aes_cycles = (uint32_t)(total / NUM_ITERS);
        print_cycles_time("   [ENC ] AES-CTR encryption of a 64-byte message",
                          cost_aes_cycles, NUM_ITERS);
    }

    /* Summary table: timer vs CPU cycles */
    print_primitive_cycle_table();
}


/* [2] Communication scenarios: unicast / multicast / broadcast */
static void benchmark_scenarios(treecast_ctx_t *ctx)
{
    printk("\n[2] Communication scenarios (NUM_DEVICES=%d, NUM_ITERS=%d)\n",
           NUM_DEVICES, NUM_ITERS);

    uint8_t key[TREECAST_KEY_BYTES];

    /* A. Unicast: pairwise between device 0 and device 1 */
    k_sleep(K_MSEC(100));
    {
        uint64_t total = 0;

        for (int i = 0; i < NUM_ITERS; i++) {
            BENCH_START();
            treecast_unicast_key(ctx, 0, 1, key);   /* HDH only */
            BENCH_END(total);
        }

        uint32_t deriv_cycles = (uint32_t)(total / NUM_ITERS);
        uint32_t total_cycles = deriv_cycles + cost_aes_cycles;

        print_cycles_time("   [UNICAST] key derivation (HDH only)",
                          deriv_cycles, NUM_ITERS);
        print_cycles_time("   [UNICAST] payload encryption (AES-CTR, 64 B)",
                          cost_aes_cycles, NUM_ITERS);
        print_cycles_time("   [UNICAST] total (HDH + AES-CTR)",
                          total_cycles, NUM_ITERS);
    }

    /* B. Multicast: subtree [0..3] */
    k_sleep(K_MSEC(100));
    {
        uint64_t total = 0;

        for (int i = 0; i < NUM_ITERS; i++) {
            BENCH_START();
            treecast_multicast_key(ctx, 0, 3, key); /* tree lookup only */
            BENCH_END(total);
        }

        uint32_t retr_cycles = (uint32_t)(total / NUM_ITERS);
        uint32_t total_cycles = retr_cycles + cost_aes_cycles;

        print_cycles_time("   [MULTICAST] key retrieval for subtree [0..3]",
                          retr_cycles, NUM_ITERS);
        print_cycles_time("   [MULTICAST] payload encryption (AES-CTR, 64 B)",
                          cost_aes_cycles, NUM_ITERS);
        print_cycles_time("   [MULTICAST] total (retrieval + AES-CTR)",
                          total_cycles, NUM_ITERS);
    }

    /* C. Broadcast: global root key */
    k_sleep(K_MSEC(100));
    {
        uint64_t total = 0;

        for (int i = 0; i < NUM_ITERS; i++) {
            BENCH_START();
            treecast_broadcast_key(ctx, key);       /* root only */
            BENCH_END(total);
        }

        uint32_t retr_cycles = (uint32_t)(total / NUM_ITERS);
        uint32_t total_cycles = retr_cycles + cost_aes_cycles;

        print_cycles_time("   [BROADCAST] root key retrieval (global)",
                          retr_cycles, NUM_ITERS);
        print_cycles_time("   [BROADCAST] payload encryption (AES-CTR, 64 B)",
                          cost_aes_cycles, NUM_ITERS);
        print_cycles_time("   [BROADCAST] total (retrieval + AES-CTR)",
                          total_cycles, NUM_ITERS);
    }
}

/* [3] Dynamic membership: path rekey cost */
static void benchmark_dynamic(treecast_ctx_t *ctx)
{
    printk("\n[3] Dynamic membership (path rekey from leaf 0 to root)\n");

    uint64_t total = 0;

    for (int i = 0; i < NUM_ITERS; i++) {
        BENCH_START();
        treecast_rekey_path(ctx, 0);   /* simulate rekey of device 0 */
        BENCH_END(total);
    }

    uint32_t avg_cycles = (uint32_t)(total / NUM_ITERS);
    print_cycles_time("   [REKEY] path rekey cost (N = 8 devices)",
                      avg_cycles, NUM_ITERS);
}

/* [4] Storage */
static void benchmark_storage(void)
{
    printk("\n[4] Storage cost (RAM)\n");
    printk("   [STRUCT] treecast_ctx_t (N=%d) : %d bytes\n",
           NUM_DEVICES, (int)sizeof(treecast_ctx_t));
    printk("   [STRUCT] tc_node_t             : %d bytes\n",
           (int)sizeof(tc_node_t));
    printk("   [STRUCT] tc_ec_keypair_t       : %d bytes\n",
           (int)sizeof(tc_ec_keypair_t));
}

/* [5] Scalability projection */
static void project_scalability(void)
{
    printk("\n[5] Scalability projection (theoretical model)\n");
    printk("   Model: Path_Cost(N) = ceil(log2 N) * Hash_Cost\n");
    printk("   Hash_Cost (from [HASH]): %u timer cycles per hash\n",
           cost_hash_cycles);

    int sizes[] = {10, 100, 1000, 10000, 100000};
    int num_sizes = sizeof(sizes) / sizeof(sizes[0]);

    printk("   | Devices (N) | Height | Rekey (cycles) | Rekey (ms) |\n");
    printk("   |-------------|--------|----------------|------------|\n");

    for (int i = 0; i < num_sizes; i++) {
        int n = sizes[i];

        /* Height of balanced binary tree ≈ ceil(log2 N) */
        int height = 0;
        int tmp = n - 1;
        while (tmp > 0) {
            tmp >>= 1;
            height++;
        }
        if (height == 0) height = 1;

        uint32_t path_cycles = (uint32_t)(height * cost_hash_cycles);
        uint64_t ns          = cycles_to_ns(path_cycles);
        uint32_t ms_int      = (uint32_t)(ns / 1000000ull);
        uint32_t ms_frac     = (uint32_t)((ns % 1000000ull) / 1000ull);

        printk("   | %-11d | %-6d | %-14u | %4u.%03u ms |\n",
               n, height, path_cycles, ms_int, ms_frac);
    }
}



int main(void)
{
    
    k_sleep(K_MSEC(100));

    printk("\n=================================================\n");
    printk("   TreeCast benchmarking suite\n");
    printk("   NUM_DEVICES = %d, NUM_ITERS = %d, MSG_SIZE = %d bytes\n",
           NUM_DEVICES, NUM_ITERS, MSG_SIZE);
    printk("   Timer clock (CONFIG_SYS_CLOCK_HW_CYCLES_PER_SEC) = %u Hz\n",
           CONFIG_SYS_CLOCK_HW_CYCLES_PER_SEC);
    printk("   Assumed CPU core clock                               = %u Hz\n",
           CPU_FREQ_HZ);
    printk("=================================================\n");

    treecast_ctx_t *ctx = &g_ctx;

    k_sleep(K_MSEC(100));

    int ret = treecast_init(ctx, NUM_DEVICES);
    if (ret != 0) {
        printk("[ERROR] treecast_init failed: %d\n", ret);
        return 0;
    }

    k_sleep(K_MSEC(100));

    ret = treecast_derive_all(ctx);
    if (ret != 0) {
        printk("[ERROR] treecast_derive_all failed: %d\n", ret);
        return 0;
    }

    k_sleep(K_MSEC(100));
    benchmark_atomics();

    k_sleep(K_MSEC(100));
    benchmark_scenarios(ctx);

    k_sleep(K_MSEC(100));
    benchmark_dynamic(ctx);

    k_sleep(K_MSEC(100));
    benchmark_storage();

    k_sleep(K_MSEC(100));
    project_scalability();

    printk("\n=== COMPLETE ===\n");
    return 0;
}
```

## src/crypto_backend.c
```c
#include "crypto_backend.h"
#include <string.h>

#include <zephyr/kernel.h>
#include <zephyr/random/random.h>
#include <zephyr/logging/log.h>

#include <ocrypto_ecdh_p256.h>
#include <ocrypto_sha256.h>

/* AES (CTR) */
extern void soft_aes_ctr_encrypt(const uint8_t *key,
                                 const uint8_t *iv,
                                 const uint8_t *data,
                                 uint32_t len,
                                 uint8_t *out);

LOG_MODULE_REGISTER(crypto_backend, LOG_LEVEL_INF);

/* SHA-256 hash */
int tc_hash(const uint8_t *in, size_t in_len, uint8_t out[32])
{
    ocrypto_sha256_ctx ctx;

    ocrypto_sha256_init(&ctx);
    ocrypto_sha256_update(&ctx, in, in_len);
    ocrypto_sha256_final(&ctx, out);

    return 0;
}

/* EC keypair generation on secp256r1 (P-256) */
int tc_ec_keypair_gen(tc_ec_keypair_t *kp)
{
    /* Random private key from Zephyr CSPRNG */
    sys_csrand_get(kp->priv, TREECAST_PRIV_BYTES);

    /* Derive public key */
    int ret = ocrypto_ecdh_p256_public_key(kp->pub, kp->priv);
    return (ret == 0) ? 0 : -1;
}

/* Hybrid Diffie-Hellman: H(sk * pk_peer) */
int tc_ec_hdh(const uint8_t priv[TREECAST_PRIV_BYTES],
              const uint8_t peer_pub[TREECAST_PUB_BYTES],
              uint8_t out[TREECAST_KEY_BYTES])
{
    uint8_t shared_secret[32];

    int ret = ocrypto_ecdh_p256_common_secret(shared_secret,
                                              priv,
                                              peer_pub);
    if (ret != 0) {
        return -1;
    }

    return tc_hash(shared_secret, sizeof(shared_secret), out);
}

/* Symmetric encryption
 *
 * For benchmarking, we implement AES-CTR in software and fabricate an
 * authentication tag. This gives us realistic CPU load without depending
 * on a specific hardware AEAD engine.
 */
int tc_aes_ctr_encrypt(const uint8_t *key,
                       const uint8_t *iv,
                       size_t iv_len,
                       const uint8_t *input,
                       size_t len,
                       uint8_t *output,
                       uint8_t *tag,
                       size_t tag_len)
{
    uint8_t safe_iv[16] = {0};

    /* Clamp IV to 16 bytes and copy */
    if (iv_len > sizeof(safe_iv)) {
        iv_len = sizeof(safe_iv);
    }
    memcpy(safe_iv, iv, iv_len);

    soft_aes_ctr_encrypt(key, safe_iv, input, (uint32_t)len, output);

    /* Dummy tag content; cost is dominated by AES anyway */
    if (tag && tag_len > 0) {
        memset(tag, 0xAA, tag_len);
    }

    return 0;
}
```

## src/crypto_backend.h
```c
#ifndef CRYPTO_BACKEND_H
#define CRYPTO_BACKEND_H

#include <stdint.h>
#include <stddef.h>

#define TREECAST_KEY_BYTES 32   // 256-bit keys
#define TREECAST_PRIV_BYTES 32
#define TREECAST_PUB_BYTES  64  // uncompressed x||y

typedef struct {
    uint8_t priv[TREECAST_PRIV_BYTES];
    uint8_t pub[TREECAST_PUB_BYTES];
} tc_ec_keypair_t;

// Generate EC keypair on secp256r1
int tc_ec_keypair_gen(tc_ec_keypair_t *kp);

// Compute HDH shared secret: H(sk * pk_peer)
int tc_ec_hdh(const uint8_t priv[TREECAST_PRIV_BYTES],
              const uint8_t peer_pub[TREECAST_PUB_BYTES],
              uint8_t out[TREECAST_KEY_BYTES]);

// SHA-256 hash
int tc_hash(const uint8_t *in, size_t in_len,
            uint8_t out[32]);

#endif
```

## src/soft_aes.c
```c
#include <stdint.h>
#include <string.h>

static const uint8_t sbox[256] = {
    0x63,0x7c,0x77,0x7b,0xf2,0x6b,0x6f,0xc5,0x30,0x01,0x67,0x2b,0xfe,0xd7,0xab,0x76,
    0xca,0x82,0xc9,0x7d,0xfa,0x59,0x47,0xf0,0xad,0xd4,0xa2,0xaf,0x9c,0xa4,0x72,0xc0,
    0xb7,0xfd,0x93,0x26,0x36,0x3f,0xf7,0xcc,0x34,0xa5,0xe5,0xf1,0x71,0xd8,0x31,0x15,
    0x04,0xc7,0x23,0xc3,0x18,0x96,0x05,0x9a,0x07,0x12,0x80,0xe2,0xeb,0x27,0xb2,0x75,
    0x09,0x83,0x2c,0x1a,0x1b,0x6e,0x5a,0xa0,0x52,0x3b,0xd6,0xb3,0x29,0xe3,0x2f,0x84,
    0x53,0xd1,0x00,0xed,0x20,0xfc,0xb1,0x5b,0x6a,0xcb,0xbe,0x39,0x4a,0x4c,0x58,0xcf,
    0xd0,0xef,0xaa,0xfb,0x43,0x4d,0x33,0x85,0x45,0xf9,0x02,0x7f,0x50,0x3c,0x9f,0xa8,
    0x51,0xa3,0x40,0x8f,0x92,0x9d,0x38,0xf5,0xbc,0xb6,0xda,0x21,0x10,0xff,0xf3,0xd2,
    0xcd,0x0c,0x13,0xec,0x5f,0x97,0x44,0x17,0xc4,0xa7,0x7e,0x3d,0x64,0x5d,0x19,0x73,
    0x60,0x81,0x4f,0xdc,0x22,0x2a,0x90,0x88,0x46,0xee,0xb8,0x14,0xde,0x5e,0x0b,0xdb,
    0xe0,0x32,0x3a,0x0a,0x49,0x06,0x24,0x5c,0xc2,0xd3,0xac,0x62,0x91,0x95,0xe4,0x79,
    0xe7,0xc8,0x37,0x6d,0x8d,0xd5,0x4e,0xa9,0x6c,0x56,0xf4,0xea,0x65,0x7a,0xae,0x08,
    0xba,0x78,0x25,0x2e,0x1c,0xa6,0xb4,0xc6,0xe8,0xdd,0x74,0x1f,0x4b,0xbd,0x8b,0x8a,
    0x70,0x3e,0xb5,0x66,0x48,0x03,0xf6,0x0e,0x61,0x35,0x57,0xb9,0x86,0xc1,0x1d,0x9e,
    0xe1,0xf8,0x98,0x11,0x69,0xd9,0x8e,0x94,0x9b,0x1e,0x87,0xe9,0xce,0x55,0x28,0xdf,
    0x8c,0xa1,0x89,0x0d,0xbf,0xe6,0x42,0x68,0x41,0x99,0x2d,0x0f,0xb0,0x54,0xbb,0x16
};

static void Cipher(const uint8_t *input,
                   uint8_t *output,
                   const uint8_t *roundKeys)
{
    uint8_t state[16];

    memcpy(state, input, 16);

    for (int i = 0; i < 16; ++i) {
        state[i] = sbox[state[i] ^ roundKeys[i]];
    }

    for (int r = 0; r < 10; r++) {
        for (int i = 0; i < 16; ++i) {
            state[i] ^= 0xAB;
        }
    }

    memcpy(output, state, 16);
}

/* AES-CTR-style encryption used only for benchmarking */
void soft_aes_ctr_encrypt(const uint8_t *key,
                          const uint8_t *iv,
                          const uint8_t *data,
                          uint32_t len,
                          uint8_t *out)
{
    uint8_t counter[16];
    uint8_t stream_block[16];
    uint8_t expandedKey[176]; 

    memset(expandedKey, 0, sizeof(expandedKey));
    memcpy(expandedKey, key, 16);

    memcpy(counter, iv, 12);
    memset(counter + 12, 0, 4);

    for (uint32_t i = 0; i < len; i++) {
        if ((i % 16) == 0) {
            Cipher(counter, stream_block, expandedKey);

            /* Increment counter (last 4 bytes) */
            for (int j = 15; j >= 12; j--) {
                if (++counter[j]) {
                    break;
                }
            }
        }

        out[i] = data[i] ^ stream_block[i % 16];
    }
}
```

## src/treecast.c
```c
#include "treecast.h"
#include <string.h>

static size_t leaf_offset(size_t num_devices) { return 1 + (num_devices - 1); }
static size_t parent(size_t idx)      { return idx / 2; }
static size_t left_child(size_t idx)  { return 2 * idx; }
static size_t right_child(size_t idx) { return 2 * idx + 1; }

int treecast_init(treecast_ctx_t *ctx, size_t num_devices)
{
    if (num_devices < 2 || num_devices > TREECAST_MAX_DEVICES) return -1;
    ctx->num_devices = num_devices;
    size_t total_nodes = 2 * num_devices;
    for (size_t i = 0; i < total_nodes; i++) ctx->nodes[i].has_secret = 0;

    for (size_t i = 0; i < num_devices; i++) {
        if (tc_ec_keypair_gen(&ctx->dev_keys[i]) != 0) return -1;
    }
    return 0;
}

int treecast_derive_all(treecast_ctx_t *ctx)
{
    size_t n = ctx->num_devices;
    size_t offset = leaf_offset(n);

    for (size_t i = 0; i < n; i++) {
        size_t idx = offset + i;
        tc_hash(ctx->dev_keys[i].pub, TREECAST_PUB_BYTES, ctx->nodes[idx].secret);
        ctx->nodes[idx].has_secret = 1;
    }

    for (size_t idx = offset - 1; idx > 0; idx--) {
        size_t l = left_child(idx);
        size_t r = right_child(idx);
        if (l >= 2 * n || r >= 2 * n) continue;
        if (!ctx->nodes[l].has_secret || !ctx->nodes[r].has_secret) continue;

        uint8_t buf[2 * TREECAST_KEY_BYTES];
        memcpy(buf, ctx->nodes[l].secret, TREECAST_KEY_BYTES);
        memcpy(buf + TREECAST_KEY_BYTES, ctx->nodes[r].secret, TREECAST_KEY_BYTES);
        tc_hash(buf, sizeof(buf), ctx->nodes[idx].secret);
        ctx->nodes[idx].has_secret = 1;
    }
    return 0;
}

int treecast_broadcast_key(treecast_ctx_t *ctx, uint8_t out[TREECAST_KEY_BYTES])
{
    if (!ctx->nodes[1].has_secret) return -1;
    memcpy(out, ctx->nodes[1].secret, TREECAST_KEY_BYTES);
    return 0;
}

static size_t lca_index(size_t a_idx, size_t b_idx)
{
    while (a_idx != b_idx) {
        if (a_idx > b_idx) a_idx = parent(a_idx);
        else b_idx = parent(b_idx);
    }
    return a_idx;
}

int treecast_multicast_key(treecast_ctx_t *ctx, size_t first_dev, size_t last_dev, uint8_t out[TREECAST_KEY_BYTES])
{
    size_t offset = leaf_offset(ctx->num_devices);
    size_t lca = lca_index(offset + first_dev, offset + last_dev);
    if (!ctx->nodes[lca].has_secret) return -1;
    memcpy(out, ctx->nodes[lca].secret, TREECAST_KEY_BYTES);
    return 0;
}

int treecast_unicast_key(treecast_ctx_t *ctx, size_t dev_i, size_t dev_j, uint8_t out[TREECAST_KEY_BYTES])
{
    return tc_ec_hdh(ctx->dev_keys[dev_i].priv, ctx->dev_keys[dev_j].pub, out);
}

/* Path Rekeying */
int treecast_rekey_path(treecast_ctx_t *ctx, size_t leaf_idx)
{
    size_t offset = leaf_offset(ctx->num_devices);
    size_t curr = offset + leaf_idx;

    uint8_t dummy_pub[64]; 
    memset(dummy_pub, 0xAB, 64); // Dummy new public key
    tc_hash(dummy_pub, 64, ctx->nodes[curr].secret);

    /* Path Update */
    curr = parent(curr);
    while (curr > 0) {
        size_t l = left_child(curr);
        size_t r = right_child(curr);
        
        uint8_t buf[64];
        memcpy(buf, ctx->nodes[l].secret, 32);
        memcpy(buf + 32, ctx->nodes[r].secret, 32);
        tc_hash(buf, 64, ctx->nodes[curr].secret);
        
        curr = parent(curr);
    }
    return 0;
}
```

## src/treecast.h
```c
#ifndef TREECAST_H
#define TREECAST_H

#include <stdint.h>
#include <stddef.h>
#include "crypto_backend.h"

#define TREECAST_MAX_DEVICES 32
#define TREECAST_MAX_NODES   (2 * TREECAST_MAX_DEVICES)

typedef struct {
    uint8_t secret[TREECAST_KEY_BYTES];
    uint8_t has_secret;
} tc_node_t;

typedef struct {
    size_t num_devices;
    tc_node_t nodes[TREECAST_MAX_NODES];
    tc_ec_keypair_t dev_keys[TREECAST_MAX_DEVICES];
} treecast_ctx_t;

/* Core protocol functions */
int treecast_init(treecast_ctx_t *ctx, size_t num_devices);
int treecast_derive_all(treecast_ctx_t *ctx);

/* Communication modes */
int treecast_unicast_key(treecast_ctx_t *ctx, size_t dev_i, size_t dev_j,
                         uint8_t out[TREECAST_KEY_BYTES]);
int treecast_multicast_key(treecast_ctx_t *ctx, size_t first_dev, size_t last_dev,
                           uint8_t out[TREECAST_KEY_BYTES]);
int treecast_broadcast_key(treecast_ctx_t *ctx,
                           uint8_t out[TREECAST_KEY_BYTES]);

/* Benchmarking helper: path rekey */
int treecast_rekey_path(treecast_ctx_t *ctx, size_t leaf_idx);

/* Symmetric crypto helper (AES-CTR wrapper) */
int tc_aes_ctr_encrypt(const uint8_t *key, const uint8_t *iv, size_t iv_len,
                       const uint8_t *input, size_t len,
                       uint8_t *output, uint8_t *tag, size_t tag_len);

#endif
```
